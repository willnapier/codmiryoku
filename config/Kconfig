## config/Kconfig
```kconfig
# config/Kconfig

menu "CodMiryoku Custom Config"

# (Optional future configs can go here)

endmenu
```

## config/boards/shields/totem/Kconfig.defconfig
```kconfig
# Copyright (c) 2022 The ZMK Contributors
# SPDX-License-Identifier: MIT

if SHIELD_TOTEM_LEFT

# Default only; CI overrides via EXTRA_CONF_FILE:
#   Totem-Mac-1 / Totem-Mac-2 / Totem-Linux-1 / Totem-Linux-2
config ZMK_KEYBOARD_NAME
    default "TOTEM"
    
config ZMK_SPLIT_ROLE_CENTRAL
    default y

endif

if SHIELD_TOTEM_LEFT || SHIELD_TOTEM_RIGHT

config ZMK_SPLIT
    default y

endif
```

## config/boards/shields/totem_left/Kconfig
```kconfig
# Totem – left half
config SHIELD_TOTEM_LEFT
    bool "Totem-left split shield"
    depends on BOARD_SEEEDUINO_XIAO_BLE
```

## config/boards/shields/totem_right/Kconfig
```kconfig
# Totem – right half
config SHIELD_TOTEM_RIGHT
    bool "Totem-right split shield"
    depends on BOARD_SEEEDUINO_XIAO_BLE
```

## config/west.yml
```yaml
manifest:
  remotes:
    - name: zmkfirmware
      url-base: https://github.com/zmkfirmware
    - name: geigeigeist
      url-base: https://github.com/GEIGEIGEIST
  projects:
    - name: zmk
      remote: zmkfirmware
      revision: main
      import: app/west.yml
    - name: totem
      remote: geigeigeist
      repo-path: zmk-config-totem
      revision: master
      path: totem
  self:
    path: config
```

## west.yml
```yaml
manifest:
  remotes:
    - name: zmkfirmware
      url-base: https://github.com/zmkfirmware
    - name: willnapier
      url-base: https://github.com/willnapier

  defaults:
    remote: zmkfirmware

  projects:
    - name: zmk
      remote: zmkfirmware
      revision: main
      import: app/west.yml

  self:
    path: config
```
