fun_layer {
  label = "FUN";
  bindings = <
    // Row 1 (Top)
                  &kp F12     &kp F7      &kp F8      &kp F9      &kp PSCRN              &none       &u_to_U_BASE   &u_to_U_EXTRA  &u_to_U_TAP   &bootloader

    // Row 2 (Home)
                  &kp F11     &kp F4      &kp F5      &kp F6      &kp SLCK               &none      &kp LSHFT     &kp LCTRL        &kp LALT      &kp LGUI

    // Row 3 (Bottom — includes outer pinkies)
    &trans        &kp F10     &kp F1      &kp F2      &kp F3      &kp PAUSE_BREAK        &none      &u_to_U_FUN    &u_to_U_MEDIA   &kp RALT      &none       &trans

    // Thumbs (Right hand only, as per Miryoku diagram)
                                             &kp K_APP     &kp SPACE      &kp TAB&       none       &none          &none
  >;
};
